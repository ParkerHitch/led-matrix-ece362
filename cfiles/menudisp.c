/* Might have a tty.h and fifo.h / fifo.c dependency? Could also be a weird platform IO thing bc
   I just copied the C testing folder from a lab because I am lazy.
*/
#include "menudisp.h"
#include "stm32f0xx.h"

// The LCD device.
// This will be initialized by LCD_direction() so that the
// width and height will be appropriate for the rotation.
// The setxcmd and setycmd will be set so that cursor selection
// is defined properly for the rotation.
lcd_dev_t lcddev;
int APP_NUM = 0; // stores where # of app program is app
int RUNNING_APP = 0; // 0 = on menu, 1 = running app
//char* APPLIST[MAXAPPS]; // acts like application struct for now
//char * MENU = "Select App:"; // text for menu

// A 16x26 font, used for writing text
static const uint16_t asc2_2616[95][26] = {
    {0x0000,0x0000,0x0000,0x0000,0x0000,0x0000,0x0000,0x0000,0x0000,0x0000,0x0000,0x0000,0x0000,0x0000,0x0000,0x0000,0x0000,0x0000,0x0000,0x0000,0x0000,0x0000,0x0000,0x0000,0x0000,0x0000}, // Ascii = [ ]
    {0x03E0,0x03E0,0x03E0,0x03E0,0x03E0,0x03E0,0x03E0,0x03E0,0x03C0,0x03C0,0x01C0,0x01C0,0x01C0,0x01C0,0x01C0,0x0000,0x0000,0x0000,0x03E0,0x03E0,0x03E0,0x0000,0x0000,0x0000,0x0000,0x0000}, // Ascii = [!]
    {0x1E3C,0x1E3C,0x1E3C,0x1E3C,0x1E3C,0x1E3C,0x1E3C,0x0000,0x0000,0x0000,0x0000,0x0000,0x0000,0x0000,0x0000,0x0000,0x0000,0x0000,0x0000,0x0000,0x0000,0x0000,0x0000,0x0000,0x0000,0x0000}, // Ascii = ["]
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    {0x0000,0x0000,0x0000,0x0000,0x0000,0x0000,0x0000,0x0000,0x0000,0x0000,0x0000,0x3F07,0x7FC7,0x73E7,0xF1FF,0xF07E,0x0000,0x0000,0x0000,0x0000,0x0000,0x0000,0x0000,0x0000,0x0000,0x0000}, // Ascii = [~]
};

void LCD_WriteReg(uint8_t LCD_Reg, uint16_t LCD_RegValue)
{
    LCD_WR_REG(LCD_Reg);
    LCD_WR_DATA(LCD_RegValue);
}

// i didn't know this existed before doing all the font manuevering/rotating imma kms
void LCD_direction(u8 direction)
{
    lcddev.setxcmd = 0x2A;
    lcddev.setycmd = 0x2B;
    lcddev.wramcmd = 0x2C;
    switch (direction) {
    case 0:
        lcddev.width = LCD_W;
        lcddev.height = LCD_H;
        LCD_WriteReg(0x36, (1 << 3) | (0 << 6) | (0 << 7));//BGR==1,MY==0,MX==0,MV==0
        break;
    case 1:
        lcddev.width = LCD_H;
        lcddev.height = LCD_W;
        LCD_WriteReg(0x36, (1 << 3) | (0 << 7) | (1 << 6) | (1 << 5));//BGR==1,MY==1,MX==0,MV==1
        break;
    case 2:
        lcddev.width = LCD_W;
        lcddev.height = LCD_H;
        LCD_WriteReg(0x36, (1 << 3) | (1 << 6) | (1 << 7));//BGR==1,MY==0,MX==0,MV==0
        break;
    case 3:
        lcddev.width = LCD_H;
        lcddev.height = LCD_W;
        LCD_WriteReg(0x36, (1 << 3) | (1 << 7) | (1 << 5));//BGR==1,MY==1,MX==0,MV==1
        break;
    default:break;
    }
}

// Set the CS pin low if val is non-zero.
// Note that when CS is being set high again, wait on SPI to not be busy.
static void tft_select(int val)
{
    if (val == 0) {
        while (SPI2->SR & SPI_SR_BSY);
        do { GPIOB->BSRR = GPIO_BSRR_BS_10; } while (0);
    }
    else {
        while ((GPIOB->ODR & (1 << 10)) == 0) {
            ;
        }
        do { GPIOB->BSRR = GPIO_BSRR_BR_10; } while (0);
    }
}

// If val is non-zero, set nRESET low to reset the display.
static void tft_reset(int val)
{
    if (val) {
        do { GPIOB->BSRR = GPIO_BSRR_BR_11; } while (0);
    }
    else {
        do { GPIOB->BSRR = GPIO_BSRR_BS_11; } while (0);
    }
}

static void tft_reg_select(int val)
{
    if (val == 1) { // select registers
        do { GPIOB->BSRR = GPIO_BSRR_BR_12; } while (0); // clear
    }
    else { // select data
        do { GPIOB->BSRR = GPIO_BSRR_BS_12; } while (0); // set
    }
}

// resets lcd
void LCD_Reset(void)
{
    lcddev.reset(1);      // Assert reset
    nano_wait(100000000); // Wait
    lcddev.reset(0);      // De-assert reset
    nano_wait(50000000);  // Wait
}

// more lci setup for lcd
void init_spi2_slow()
{
    RCC->AHBENR |= RCC_AHBENR_GPIOBEN;
    RCC->APB1ENR |= RCC_APB1ENR_SPI2EN;
    SPI2->CR1 &= ~(SPI_CR1_SPE);
    GPIOB->MODER |= 0xa8000000;
    GPIOB->AFR[1] &= ~(0xfff00000);
    SPI2->CR1 |= 0x7 << 3;
    SPI2->CR1 |= SPI_CR1_MSTR;
    SPI2->CR2 |= 0x7 << 8;
    SPI2->CR2 &= ~(0x8 << 8);
    SPI2->CR1 |= SPI_CR1_SSM;
    SPI2->CR1 |= SPI_CR1_SSI;
    SPI2->CR2 |= SPI_CR2_FRXTH;
    SPI2->CR1 |= SPI_CR1_SPE;
}

// more spi setup for lcd
void sdcard_io_high_speed()
{
    SPI2->CR1 &= ~(SPI_CR1_SPE);
    SPI2->CR1 &= ~(0x7 << 3);
    SPI2->CR1 |= 0x1 << 3;
    SPI2->CR1 |= SPI_CR1_SPE;
}

// sets up spi for lcd
void init_lcd_spi()
{
    RCC->AHBENR |= RCC_AHBENR_GPIOBEN;
    GPIOB->MODER &= ~0x03f00000;
    GPIOB->MODER |= 0x01500000;
    init_spi2_slow();
    sdcard_io_high_speed();
}

// sets up LCD
void LCD_Setup() {
    init_lcd_spi();
    tft_select(0);
    tft_reset(0);
    tft_reg_select(0);
    LCD_Init(tft_reset, tft_select, tft_reg_select);
}

void LCD_WR_REG(uint8_t data)
{
    while ((SPI->SR & SPI_SR_BSY) != 0)
        ;
    // Don't clear RS until the previous operation is done.
    lcddev.reg_select(1);
    *((volatile uint8_t*)&SPI->DR) = data;
}

// Write 8-bit data to the LCD
void LCD_WR_DATA(uint8_t data)
{
    while ((SPI->SR & SPI_SR_BSY) != 0)
        ;
    // Don't set RS until the previous operation is done.
    lcddev.reg_select(0);
    *((volatile uint8_t*)&SPI->DR) = data;
}

// Sets up / initializes the entire LCD, NECESSARY
void LCD_Init(void (*reset)(int), void (*select)(int), void (*reg_select)(int))
{
    lcddev.reset = tft_reset;
    lcddev.select = tft_select;
    lcddev.reg_select = tft_reg_select;
    if (reset)
        lcddev.reset = reset;
    if (select)
        lcddev.select = select;
    if (reg_select)
        lcddev.reg_select = reg_select;
    lcddev.select(1);
    LCD_Reset();
    // Initialization sequence for 2.2inch ILI9341
    LCD_WR_REG(0xCF);
    LCD_WR_DATA(0x00);
    LCD_WR_DATA(0xD9); // C1
    LCD_WR_DATA(0X30);
    LCD_WR_REG(0xED);
    LCD_WR_DATA(0x64);
    LCD_WR_DATA(0x03);
    LCD_WR_DATA(0X12);
    LCD_WR_DATA(0X81);
    LCD_WR_REG(0xE8);
    LCD_WR_DATA(0x85);
    LCD_WR_DATA(0x10);
    LCD_WR_DATA(0x7A);
    LCD_WR_REG(0xCB);
    LCD_WR_DATA(0x39);
    LCD_WR_DATA(0x2C);
    LCD_WR_DATA(0x00);
    LCD_WR_DATA(0x34);
    LCD_WR_DATA(0x02);
    LCD_WR_REG(0xF7);
    LCD_WR_DATA(0x20);
    LCD_WR_REG(0xEA);
    LCD_WR_DATA(0x00);
    LCD_WR_DATA(0x00);
    LCD_WR_REG(0xC0);    // Power control
    LCD_WR_DATA(0x21);   // VRH[5:0]  //1B
    LCD_WR_REG(0xC1);    // Power control
    LCD_WR_DATA(0x12);   // SAP[2:0];BT[3:0] //01
    LCD_WR_REG(0xC5);    // VCM control
    LCD_WR_DATA(0x39);   // 3F
    LCD_WR_DATA(0x37);   // 3C
    LCD_WR_REG(0xC7);    // VCM control2
    LCD_WR_DATA(0XAB);   // B0
    LCD_WR_REG(0x36);    // Memory Access Control
    LCD_WR_DATA(0x48);
    LCD_WR_REG(0x3A);
    LCD_WR_DATA(0x55);
    LCD_WR_REG(0x53);    // Backlight Control
    LCD_WR_DATA(0x24);
    LCD_WR_REG(0x51);    // Brightness Control
    LCD_WR_DATA(0xFF);
    LCD_WR_REG(0xBF);    // BL EN
    LCD_WR_DATA(0x04);
    LCD_WR_REG(0xB1);
    LCD_WR_DATA(0x00);
    LCD_WR_DATA(0x1B);   // 1A
    LCD_WR_REG(0xB6);    // Display Function Control
    LCD_WR_DATA(0x0A);
    LCD_WR_DATA(0xA2);
    LCD_WR_REG(0xF2);    // 3Gamma Function Disable
    LCD_WR_DATA(0x00);
    LCD_WR_REG(0x26);    // Gamma curve selected
    LCD_WR_DATA(0x01);

    LCD_WR_REG(0xE0);     // Set Gamma
    LCD_WR_DATA(0x0F);
    LCD_WR_DATA(0x23);
    LCD_WR_DATA(0x1F);
    LCD_WR_DATA(0x0B);
    LCD_WR_DATA(0x0E);
    LCD_WR_DATA(0x08);
    LCD_WR_DATA(0x4B);
    LCD_WR_DATA(0XA8);
    LCD_WR_DATA(0x3B);
    LCD_WR_DATA(0x0A);
    LCD_WR_DATA(0x14);
    LCD_WR_DATA(0x06);
    LCD_WR_DATA(0x10);
    LCD_WR_DATA(0x09);
    LCD_WR_DATA(0x00);
    LCD_WR_REG(0XE1);      // Set Gamma
    LCD_WR_DATA(0x00);
    LCD_WR_DATA(0x1C);
    LCD_WR_DATA(0x20);
    LCD_WR_DATA(0x04);
    LCD_WR_DATA(0x10);
    LCD_WR_DATA(0x08);
    LCD_WR_DATA(0x34);
    LCD_WR_DATA(0x47);
    LCD_WR_DATA(0x44);
    LCD_WR_DATA(0x05);
    LCD_WR_DATA(0x0B);
    LCD_WR_DATA(0x09);
    LCD_WR_DATA(0x2F);
    LCD_WR_DATA(0x36);
    LCD_WR_DATA(0x0F);
    LCD_WR_REG(0x2B);
    LCD_WR_DATA(0x00);
    LCD_WR_DATA(0x00);
    LCD_WR_DATA(0x01);
    LCD_WR_DATA(0x3f);
    LCD_WR_REG(0x2A);
    LCD_WR_DATA(0x00);
    LCD_WR_DATA(0x00);
    LCD_WR_DATA(0x00);
    LCD_WR_DATA(0xef);
    LCD_WR_REG(0x11);     // Exit Sleep
    nano_wait(120000000); // Wait 120 ms
    LCD_WR_REG(0x29);     // Display on

    LCD_direction(0);
    lcddev.select(0);
}

// Sets "window" of frames desired to change
void LCD_SetWindow(uint16_t xStart, uint16_t yStart, uint16_t xEnd, uint16_t yEnd)
{
    LCD_WR_REG(lcddev.setxcmd);
    LCD_WR_DATA(xStart >> 8);
    LCD_WR_DATA(0x00FF & xStart);
    LCD_WR_DATA(xEnd >> 8);
    LCD_WR_DATA(0x00FF & xEnd);

    LCD_WR_REG(lcddev.setycmd);
    LCD_WR_DATA(yStart >> 8);
    LCD_WR_DATA(0x00FF & yStart);
    LCD_WR_DATA(yEnd >> 8);
    LCD_WR_DATA(0x00FF & yEnd);

    LCD_WriteRAM_Prepare();
}

// idk ngl
void LCD_WriteRAM_Prepare(void)
{
    LCD_WR_REG(lcddev.wramcmd);
}

// idk ngl
void LCD_WriteData16_Prepare()
{
    lcddev.reg_select(0);
    SPI->CR2 |= SPI_CR2_DS;
}

// Write 16-bit data
void LCD_WriteData16(u16 data)
{
    while ((SPI->SR & SPI_SR_TXE) == 0);
    SPI->DR = data;
}

// Finish writing 16-bit data
void LCD_WriteData16_End()
{
    SPI->CR2 &= ~SPI_CR2_DS; // bad value forces it back to 8-bit mode
}

// draws a char on the screen
void _LCD_DrawChar(u16 x, u16 y, u16 fc, u16 bc, char num, u8 size)
{
    int32_t temp;
    int32_t pos, t;
    num = num - ' ';
    int upperbound = 16;
    LCD_SetWindow(x, y, x + size - 1, y + upperbound - 1);
    LCD_WriteData16_Prepare();
    for (t = 0;t < upperbound;t++)
    {
        for (pos = 0;pos < size;pos++)
        {
            temp = asc2_2616[(int)num][size - pos - 1];
            if ((temp << t) & 0x8000)
                LCD_WriteData16(fc);
            else
                LCD_WriteData16(bc);
        }
    }
    LCD_WriteData16_End();
}

// sets the entire screen to a single color
void LCD_Clear(u16 Color)
{
    lcddev.select(1);
    unsigned int i, m;
    LCD_SetWindow(0, 0, lcddev.width - 1, lcddev.height - 1);
    LCD_WriteData16_Prepare();
    for (i = 0;i < lcddev.height;i++)
    {
        for (m = 0;m < lcddev.width;m++)
        {
            LCD_WriteData16(Color);
        }
    }
    LCD_WriteData16_End();
    lcddev.select(0);
}

// sets up drawing char
void LCD_DrawChar(u16 x, u16 y, u16 fc, u16 bc, char num, u8 size)
{
    lcddev.select(1);
    _LCD_DrawChar(x, y, fc, bc, num, size);
    lcddev.select(0);
}

// draws a string by iterating through DrawChar
void LCD_DrawString(u16 x, u16 y, u16 fc, u16 bg, const char* p, u8 size)
{
    lcddev.select(1);
    int upperbound = 16;
    while ((*p <= '~') && (*p >= ' '))
    {
        if (x > (lcddev.width - 1) || y > (lcddev.height - 1))
            return;
        _LCD_DrawChar(x, y, fc, bg, *p, size);
        y += upperbound;
        p++;
    }
    lcddev.select(0);
}

// draws a filled rectangle
static void _LCD_Fill(u16 sx, u16 sy, u16 ex, u16 ey, u16 color)
{
    u16 i, j;
    u16 width = ex - sx + 1;
    u16 height = ey - sy + 1;
    LCD_SetWindow(sx, sy, ex, ey);
    LCD_WriteData16_Prepare();
    for (i = 0;i < height;i++)
    {
        for (j = 0;j < width;j++)
            LCD_WriteData16(color);
    }
    LCD_WriteData16_End();
}

// sets up drawing a filled rectangle
void LCD_DrawFillRectangle(u16 x1, u16 y1, u16 x2, u16 y2, u16 c)
{
    lcddev.select(1);
    _LCD_Fill(x1, y1, x2, y2, c);
    lcddev.select(0);
}

// testing with buttons


// testing going up with buttons
// void EXTI0_1_IRQHandler() {
//     EXTI -> PR |= EXTI_PR_PR0;
//     if (!RUNNING_APP)
//     {
//         APP_NUM--;
//         if ((APP_NUM % 7 == 6))
//         {
//             shift_screen(1);
//         }
//         if (APP_NUM < 0)
//         {
//             APP_NUM = MAXAPPS - 1;
//             shift_screen(1);
//         }
//         update_display();
//     }  
// }

// testing going down with buttons
// void EXTI2_3_IRQHandler() {
//     EXTI -> PR |= EXTI_PR_PR2;
//     if (!RUNNING_APP)
//     {
//         APP_NUM++;
//         if (!(APP_NUM % 7) && (APP_NUM != MAXAPPS))
//         {
//             shift_screen(0);
//         }
//         if (APP_NUM >= MAXAPPS)
//         {
//             APP_NUM = 0;
//             shift_screen(0);
//         }
//         update_display();
//     }
// }

// testing switching screens / selecting with button
// void EXTI4_15_IRQHandler() {
// 	EXTI -> PR |= EXTI_PR_PR2;
//     if (RUNNING_APP)
//     {
//         reload_menu();
//     }
//     else
//     {
//         char* first = "Richard"; // test value, REMOVE LATER
//         char* last = "Ye"; // test value, REMOVE LATER
//         jump_to_app(APPLIST[APP_NUM], first, last);
//     }
// }

// Jumps to app description page
void jump_to_app(const Application* app)
{
    RUNNING_APP = 1;
    char* by = "By:";
    char* instruction1 = "Press joystick";
    char* instruction2 = "down to go";
    char* back = "Back";
    LCD_Clear(SCREEN_WHITE);
    LCD_DrawFillRectangle(204, 0, 240, 320, LIGHTBLUE); // menu background
    LCD_DrawString(209, 5, SCREEN_WHITE, LIGHTBLUE, app->name, 26); // menu text
    LCD_DrawString(173, 5, SCREEN_BLACK, SCREEN_WHITE, by, 26);
    LCD_DrawString(173, 53, SCREEN_BLACK, SCREEN_WHITE, app->authorfirst, 26);
    LCD_DrawString(145, 53, SCREEN_BLACK, SCREEN_WHITE, app->authorlast, 26);
    LCD_DrawString(61, 21, SCREEN_BLACK, SCREEN_WHITE, instruction1, 26);
    LCD_DrawString(33, 21, SCREEN_BLACK, SCREEN_WHITE, instruction2, 26);
    LCD_DrawString(5, 21, SCREEN_BLACK, SCREEN_WHITE, back, 26);
    LCD_DrawChar(5, 5, SCREEN_BLACK, SCREEN_WHITE, 62, 26);
}

// Reloads the "Select App:" menu
void reload_menu(const char* MENU, const Application* const* APPLIST)
{
    RUNNING_APP = 0;
    int find_start = APP_NUM - (APP_NUM % 7);
    // SETS UP STARTING SCREEN
    LCD_Clear(SCREEN_WHITE);
    LCD_DrawFillRectangle(204, 0, 240, 320, LIGHTBLUE); // menu background
    LCD_DrawString(209, 5, SCREEN_WHITE, LIGHTBLUE, MENU, 26); // menu text
    // loads correct 7 applications
    for (int i = find_start; i < (find_start + 7); i++)
    {
        LCD_DrawString(173 - (28 * (i % 7)), 21, SCREEN_BLACK, SCREEN_WHITE, APPLIST[i]->name, 26);
        if (i >= (MAXAPPS - 1)) // ends loading when reaching end of apps
        {
            i = find_start + 7;
        }
    }
    update_display();
}

// Shift screen up or down depending on the direction
void shift_screen(int dir, const Application* const* APPLIST)
{
    // 0 = down, 1 = up
    // LCD_Clear(0xffff);
    // LCD_DrawFillRectangle(204, 0, 240, 320, LIGHTBLUE);
    // LCD_DrawString(209, 5, SCREEN_WHITE, LIGHTBLUE, MENU, 26);
    LCD_DrawFillRectangle(0, 0, 203, 320, SCREEN_WHITE); // loads white box for apps
    if (dir)
    {
        // loads apps when changing screen upward
        for (int i = APP_NUM; i > (APP_NUM - 7); i--)
        {
            LCD_DrawString(173 - (28 * (i % 7)), 21, SCREEN_BLACK, SCREEN_WHITE, APPLIST[i]->name, 26);
            if ((i % 7) == 0) // ends loading when reaching top of last bit of apps
            {
                i = APP_NUM - 7;
            }
        }
    }
    else
    {
        // loads apps when changing screens down
        for (int i = APP_NUM; i < (APP_NUM + 7); i++)
        {
            LCD_DrawString(173 - (28 * (i % 7)), 21, SCREEN_BLACK, SCREEN_WHITE, APPLIST[i]->name, 26);
            if (i >= (MAXAPPS - 1)) // ends loading when reaching end of apps
            {
                i = APP_NUM + 7;
            }
        }
    }
}

// updates arrow and scroll bar
void update_display()
{
    int change_amnt = APP_NUM % MAXAPPS; // for % of scroll bar calculations
    LCD_DrawFillRectangle(0, 0, 201, 21, SCREEN_WHITE);
    LCD_DrawChar(173 - (28 * (APP_NUM % 7)), 5, SCREEN_BLACK, SCREEN_WHITE, 62, 26); // each "line" for text is 28 pixels apart with max of 7 apps per line
    LCD_DrawFillRectangle(0, 310, 203, 320, GRAY);
    LCD_DrawFillRectangle(203 - (203 * (change_amnt + 1) / MAXAPPS), 310, 203 - (203 * change_amnt / MAXAPPS), 320, LIGHTGRAY); //percentage calcs for filling scroll bar
}

// int main() {
//     internal_clock();
//     init_exti();
//     LCD_Setup();
//     // nano_wait(10000000);
//     // ACT LIKE THIS IS US LOADING IN THE APPLICATIONS TO THE APPLICATION STRUCT
//     APPLIST[0] = "Never";
//     APPLIST[1] = "gonna";
//     APPLIST[2] = "give";
//     APPLIST[3] = "you";
//     APPLIST[4] = "up";
//     APPLIST[5] = "never";
//     APPLIST[6] = "gonna";
//     APPLIST[7] = "let";
//     APPLIST[8] = "you";
//     APPLIST[9] = "down.";
//     // SETS UP STARTING SCREEN
//     LCD_Clear(SCREEN_WHITE);
//     LCD_DrawFillRectangle(204, 0, 240, 320, LIGHTBLUE); // menu background
//     LCD_DrawString(209, 5, SCREEN_WHITE, LIGHTBLUE, MENU, 26); // menu text
//     // loads first 7 applications
//     for (int i = 0; i < 7; i++)
//     {
//         LCD_DrawString(173 - (28 * (i % 7)), 21, SCREEN_BLACK, SCREEN_WHITE, APPLIST[i], 26);
//     }
//     // loads arrow
//     LCD_DrawFillRectangle(0, 0, 201, 21, SCREEN_WHITE);
//     LCD_DrawChar(173, 5, SCREEN_BLACK, SCREEN_WHITE, 62, 26);
//     // loads scroll bar
//     LCD_DrawFillRectangle(0, 310, 203, 320, GRAY);
//     LCD_DrawFillRectangle(174, 310, 203, 320, LIGHTGRAY);
//     while(1)
//     {
//         nano_wait(1000);
//     }
// }

